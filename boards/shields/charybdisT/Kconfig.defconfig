## boards/shields/charybdisT/Kconfig.defconfig
```kconfig
# Copyright (c) 2020 The ZMK Contributors
# SPDX-License-Identifier: MIT
if SHIELD_CHARYBDIST_LEFT

config ZMK_KEYBOARD_NAME
    default "charybdist"

config ZMK_SPLIT_ROLE_CENTRAL
    default y

endif


if SHIELD_CHARYBDIST_LEFT || SHIELD_CHARYBDIST_RIGHT

config ZMK_SPLIT
    default y
endif
```

## config/Kconfig.shield
```kconfig
# Copyright (c) 2020 The ZMK Contributors
# SPDX-License-Identifier: MIT

config SHIELD_CHARYBDIST_LEFT
    def_bool $(shields_list_contains,charybdisT_left)

config SHIELD_CHARYBDIST_RIGHT
    def_bool $(shields_list_contains,charybdisT_right)
```
